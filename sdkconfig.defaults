## sdkconfig.defaults
```kconfig
#
# ESP32-S3R8 embedded PSRAM — 80MHz is flaky on rev v0.2
# Force Octal mode at 40MHz
#
CONFIG_SPIRAM_MODE_OCT=y
CONFIG_SPIRAM_SPEED_40M=y
CONFIG_SPIRAM_SPEED=40
```
